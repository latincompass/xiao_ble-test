## config/west.yml
```yaml
manifest:
  remotes:
    - name: zmkfirmware
      url-base: https://github.com/zmkfirmware
  projects:
    - name: zmk
      remote: zmkfirmware
      revision: v0.5.0  # 👈 固定官方稳定版！解决所有问题
      import: app/west.yml
  self:
  path: config
```
